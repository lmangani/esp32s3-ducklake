## sdkconfig.defaults
```kconfig
# ESP32-C6 Configuration
# Note: ESP32-C6 doesn't have PSRAM, uses internal SRAM only
# Increase stack size for DuckDB/Parquet operations
CONFIG_ESP_MAIN_TASK_STACK_SIZE=32768

# HTTP client settings
CONFIG_ESP_HTTP_CLIENT_ENABLE_HTTPS=y
CONFIG_MBEDTLS_SSL_MAX_CONTENT_LEN=16384
```
